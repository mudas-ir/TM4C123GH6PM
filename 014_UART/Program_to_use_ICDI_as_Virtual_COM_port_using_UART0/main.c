/* ------------------------------------------------------------
 * PROGRAM NAME : UART0 Loopback Communication using ICDI
 *
 * DESCRIPTION :
 * This program demonstrates UART0 transmit and receive (loopback)
 * operation on the TM4C123GH6PM microcontroller.
 *
 * - UART0 is configured for 9600 baud rate, 8 data bits,
 *   no parity, and 1 stop bit (8N1).
 * - Characters received via UART0 RX are immediately
 *   transmitted back via UART0 TX.
 * - A simple prompt ('>') is displayed to indicate readiness.
 *
 * HARDWARE CONNECTIONS :
 * UART0 RX  -> PA0 (connected internally to ICDI debugger)
 * UART0 TX  -> PA1 (connected internally to ICDI debugger)
 *
 * NOTE :
 * PA0 and PA1 are directly connected to the on-board ICDI
 * (In-Circuit Debug Interface), allowing UART communication
 * with a PC through the USB cable using a virtual COM port.
 *
 * TOOLCHAIN :
 * Built and tested using Keil MDK-ARM v5 with TM4C123GH6PM.
 *
 * AUTHOR : Mudassir
 * DATE   : 17/12/2025
 * DAY    : Wednesday
 * ------------------------------------------------------------
 */

#include <stdint.h>
#include "tm4c123gh6pm.h"

/* Function prototypes */
void UART0Tx(char c);
char UART0Rx(void);
void UART0_SendString(char *string);
void delayMs(int n);

int main(void)
{
    char c;

    /* ------------------------------------------------------------
     * CLOCK CONFIGURATION
     * ------------------------------------------------------------ */

    SYSCTL_RCGCUART_R |= (1 << 0); /* Enable clock for UART0 module */
    SYSCTL_RCGCGPIO_R |= (1 << 0); /* Enable clock for GPIO Port A */

    /* ------------------------------------------------------------
     * GPIO CONFIGURATION FOR UART0
     * PA0 -> UART0 RX
     * PA1 -> UART0 TX
     * ------------------------------------------------------------ */

    GPIO_PORTA_AFSEL_R |= (3 << 0); /* Enable alternate function on PA0 & PA1 */
    GPIO_PORTA_DEN_R |= (3 << 0);   /* Enable digital functionality */
    GPIO_PORTA_PCTL_R = 0x11;       /* Configure PA0, PA1 for UART function */

    /* ------------------------------------------------------------
     * UART0 CONFIGURATION
     * ------------------------------------------------------------ */

    UART0_CTL_R &= ~(1 << 0); /* Disable UART0 before configuration */

    /*
     * Baud rate calculation:
     * System clock = 16 MHz
     * UART clock   = 16 MHz / 16 = 1 MHz
     * Baud rate    = 9600
     *
     * IBRD = 1,000,000 / 9600 ≈ 104
     * FBRD = round(0.1667 * 64) ≈ 11
     */
    UART0_IBRD_R = 104; /* Integer baud rate divisor */
    UART0_FBRD_R = 11;  /* Fractional baud rate divisor */
    //* or use the below code
    //-----------------------------------------------------------------
    // int baudRate = 9600;

    // float ibdr = 16000000.0 / (16 * baudRate);

    // int IBDR = ibdr;

    // float fbdr = ibdr - IBDR;

    // int FBDR = (fbdr * 64) + 0.5;

    // UART0_IBRD_R = IBDR;
    // UART0_FBRD_R = FBDR;
    //-----------------------------------------------------------------

    /* Line control:
     * - 8-bit word length
     * - No parity
     * - One stop bit
     * - FIFO disabled
     */
    UART0_LCRH_R = 0x60;

    UART0_CC_R = 0x0; /* Select system clock as UART clock source */

    /* Enable UART0, Transmit Enable (TXE), Receive Enable (RXE) */
    UART0_CTL_R |= (1 << 0) | (1 << 8) | (1 << 9);

    /* ------------------------------------------------------------
     * STARTUP DELAY
     * ------------------------------------------------------------ */
    delayMs(100); /* Allow UART lines to stabilize */

    UART0Tx('>'); /* Display prompt */
    delayMs(100);

    /* ------------------------------------------------------------
     * MAIN LOOP
     * ------------------------------------------------------------ */
    while (1)
    {
        c = UART0Rx(); /* Wait and receive one character */
        delayMs(100);

        UART0Tx('\n'); /* New line */
        UART0Tx('\r'); /* Carriage return */
        UART0Tx('>');  /* Prompt */
        UART0Tx(c);    /* Echo received character */
    }
}

/* ------------------------------------------------------------
 * UART0 TRANSMIT FUNCTION
 * Waits until transmit FIFO is not full, then sends a character
 * ------------------------------------------------------------ */
void UART0Tx(char c)
{
    while ((UART0_FR_R & 0x20) != 0)
        ; /* Wait until TX FIFO is not full */

    UART0_DR_R = c; /* Write character to data register */
}

/* ------------------------------------------------------------
 * UART0 RECEIVE FUNCTION
 * Waits until data is available, then reads it
 * ------------------------------------------------------------ */
char UART0Rx(void)
{
    char c;

    while ((UART0_FR_R & 0x10) != 0)
        ; /* Wait until RX FIFO is not empty */

    c = UART0_DR_R; /* Read received character */
    return c;
}

/* ------------------------------------------------------------
 * SEND STRING OVER UART0
 * ------------------------------------------------------------ */
void UART0_SendString(char *string)
{
    while (*string)
        UART0Tx(*string++);
}

/* ------------------------------------------------------------
 * SOFTWARE DELAY (Approx. 1 ms per count)
 * ------------------------------------------------------------ */
void delayMs(int n)
{
    int i, j;
    for (i = 0; i < n; i++)
        for (j = 0; j < 4000; j++)
        {
            /* Do nothing */
        }
}
