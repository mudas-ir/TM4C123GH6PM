/* ------------------------------------------------------------
 * PROGRAM NAME : UART1 Loopback Communication using TTL Converter
 *
 * DESCRIPTION :
 * This program demonstrates UART1 transmit and receive operation
 * on the TM4C123GH6PM microcontroller using an external TTL
 * (USB-to-TTL / UART-to-TTL) converter.
 *
 * - UART1 is configured for 9600 baud rate, 8 data bits,
 *   no parity, and 1 stop bit (8N1).
 * - Characters received on UART1 RX are echoed back
 *   through UART1 TX.
 * - A simple text prompt is transmitted before receiving data.
 *
 * HARDWARE CONNECTIONS :
 * UART1 RX -> PB0 (Connected to TX of TTL converter)
 * UART1 TX -> PB1 (Connected to RX of TTL converter)
 *
 * NOTE :
 * UART1 is NOT connected to the on-board ICDI debugger.
 * An external USB-to-TTL converter is required.
 *
 * TOOLCHAIN :
 * Built and tested using Keil MDK-ARM v4 with TM4C123GH6PM.
 *
 * AUTHOR : Mudassir
 * DATE   : 17/12/2025
 * DAY    : Wednesday
 * ------------------------------------------------------------
 */
#include <stdint.h>
#include "tm4c123gh6pm.h"

/* Function prototypes */
void UART1Tx(char c);
char UART1Rx(void);
void delayMs(int n);

int main(void)
{
    char c;

    /* ------------------------------------------------------------
     * CLOCK CONFIGURATION
     * ------------------------------------------------------------ */

    SYSCTL_RCGCUART_R |= 0x02; /* Enable clock for UART1 */
    SYSCTL_RCGCGPIO_R |= 0x02; /* Enable clock for GPIO Port B */

    /* ------------------------------------------------------------
     * UART1 CONFIGURATION
     * ------------------------------------------------------------ */

    UART1_CTL_R = 0x00; /* Disable UART1 before configuration */

    /*
     * Baud rate calculation:
     * System clock = 16 MHz
     * UART clock   = 16 MHz / 16 = 1 MHz
     * Baud rate    = 9600
     *
     * IBRD = 1,000,000 / 9600 ≈ 104
     * FBRD = round(0.1667 * 64) ≈ 11
     */
    UART1_IBRD_R = 104; /* Integer baud rate divisor */
    UART1_FBRD_R = 11;  /* Fractional baud rate divisor */
    //* or use the below code
    //-----------------------------------------------------------------
    // int baudRate = 9600;

    // float ibdr = 16000000.0 / (16 * baudRate);

    // int IBDR = ibdr;

    // float fbdr = ibdr - IBDR;

    // int FBDR = (fbdr * 64) + 0.5;

    // UART0_IBRD_R = IBDR;
    // UART0_FBRD_R = FBDR;
    //-----------------------------------------------------------------

    UART1_CC_R = 0x00; /* Use system clock */

    /* Line control:
     * - 8-bit data
     * - No parity
     * - 1 stop bit
     * - FIFO disabled
     */
    UART1_LCRH_R = 0x60;

    /* Enable UART1, TX, and RX */
    UART1_CTL_R = 0x301;

    /* ------------------------------------------------------------
     * GPIO CONFIGURATION FOR UART1
     * PB0 -> UART1 RX
     * PB1 -> UART1 TX
     * ------------------------------------------------------------ */

    GPIO_PORTB_DEN_R = 0x03;   /* Enable digital function on PB0, PB1 */
    GPIO_PORTB_AFSEL_R = 0x03; /* Enable alternate function on PB0, PB1 */
    GPIO_PORTB_PCTL_R = 0x11;  /* Configure PB0, PB1 for UART1 */

    delayMs(100); /* Allow signal stabilization */

    /* ------------------------------------------------------------
     * MAIN LOOP
     * ------------------------------------------------------------ */

    while (1)
    {
        /* Transmit prompt message */
        UART1Tx('E');
        UART1Tx('N');
        UART1Tx('T');
        UART1Tx('E');
        UART1Tx('R');
        UART1Tx(' ');
        UART1Tx('T');
        UART1Tx('E');
        UART1Tx('X');
        UART1Tx('T');
        UART1Tx(':');
        UART1Tx(' ');

        /* Receive a single character */
        c = UART1Rx();

        /* Echo received character */
        UART1Tx('\n');
        UART1Tx('\r');
        UART1Tx('>');
        UART1Tx(c);
        UART1Tx('\n');
        UART1Tx('\r');
    }
}

/* ------------------------------------------------------------
 * UART1 RECEIVE FUNCTION
 * Waits until data is available in RX buffer
 * ------------------------------------------------------------ */
char UART1Rx(void)
{
    char c;

    while ((UART1_FR_R & 0x10) != 0)
        ; /* Wait until RX FIFO is not empty */

    c = UART1_DR_R; /* Read received data */
    return c;
}

/* ------------------------------------------------------------
 * UART1 TRANSMIT FUNCTION
 * Waits until TX buffer is free, then sends data
 * ------------------------------------------------------------ */
void UART1Tx(char c)
{
    while ((UART1_FR_R & 0x20) != 0)
        ; /* Wait until TX FIFO is not full */

    UART1_DR_R = c; /* Write data to transmit register */
}

/* ------------------------------------------------------------
 * SOFTWARE DELAY (Approx. 1 ms per iteration)
 * ------------------------------------------------------------ */
void delayMs(int n)
{
    int i, j;
    for (i = 0; i < n; i++)
        for (j = 0; j < 4000; j++)
        {
            /* Do nothing */
        }
}
